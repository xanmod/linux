## drivers/block/zram/Kconfig
```kconfig
config ZRAM
	tristate "Compressed RAM block device support"
	depends on BLOCK && SYSFS && ZSMALLOC && CRYPTO
	select CRYPTO_LZO
	default n
	help
	  Creates virtual block devices called /dev/zramX (X = 0, 1, ...).
	  Pages written to these disks are compressed and stored in memory
	  itself. These disks allow very fast I/O and compression provides
	  good amounts of memory savings.

	  It has several use cases, for example: /tmp storage, use as swap
	  disks and maybe many more.

	  See zram.txt for more information.

config ZRAM_DEDUP
	bool "Deduplication support for ZRAM data"
	depends on ZRAM
	default n
	help
	  Deduplicate ZRAM data to reduce amount of memory consumption.
	  Advantage largely depends on the workload. In some cases, this
	  option reduces memory usage to the half. However, if there is no
	  duplicated data, the amount of memory consumption would be
	  increased due to additional metadata usage. And, there is
	  computation time trade-off. Please check the benefit before
	  enabling this option. Experiment shows the positive effect when
	  the zram is used as blockdev and is used to store build output.
```

## drivers/char/lrng/Kconfig
```kconfig
# SPDX-License-Identifier: GPL-2.0
#
# Linux Random Number Generator configuration
#

choice
	prompt "Random Number Generator Implementation"
	default RANDOM_DEFAULT_IMPL
	help
	  Select the random number generator implementation that is
	  accessible via /dev/random, /dev/urandom, getrandom(2), and
	  the in-kernel function get_random_bytes.

config RANDOM_DEFAULT_IMPL
	bool "Default Implementation"
	help
	  The default random number generator as provided with
	  drivers/char/random.c is selected with this option.

config LRNG
	bool "LRNG Implementation with SP800-90A/B/C compliance"
	select CRYPTO_LIB_SHA256 if CRYPTO
	help
	  The Linux Random Number Generator (LRNG) generates entropy
	  from different entropy sources. Each entropy source can
	  be enabled and configured independently. The interrupt
	  entropy source can be configured to be SP800-90B compliant.
	  The entire LRNG can be configured to be SP800-90C compliant.
	  Runtime-switchable cryptographic support is available.
	  The LRNG delivers significant entropy during boot.

endchoice

menu "Linux Random Number Generator Configuration"
	depends on LRNG

if LRNG

menu "Specific DRNG seeding strategies"

config LRNG_OVERSAMPLE_ENTROPY_SOURCES
	bool "Oversample entropy sources"
	default n
	help
	  When enabling this option, the entropy sources are
	  over-sampled with the following approach: First, the
	  the entropy sources are requested to provide 64 bits more
	  entropy than the size of the entropy buffer. For example,
	  if the entropy buffer is 256 bits, 320 bits of entropy
	  is requested to fill that buffer.

	  Second, the seed operation of the deterministic RNG
	  requests 128 bits more data from each entropy source than
	  the security strength of the DRNG during initialization.
	  A prerequisite for this operation is that the digest size
	  of the used hash must be at least equally large to generate
	  that buffer. If the prerequisite is not met, this
	  oversampling is not applied.

	  This strategy is intended to offset the asymptotic entropy
	  increase to reach full entropy in a buffer.

	  The strategy is consistent with the requirements in
	  NIST SP800-90C and is only enforced with fips=1.

	  If unsure, say N.

config LRNG_OVERSAMPLE_ES_BITS
	int
	default 0 if !LRNG_OVERSAMPLE_ENTROPY_SOURCES
	default 64 if LRNG_OVERSAMPLE_ENTROPY_SOURCES

config LRNG_SEED_BUFFER_INIT_ADD_BITS
	int
	default 0 if !LRNG_OVERSAMPLE_ENTROPY_SOURCES
	default 128 if LRNG_OVERSAMPLE_ENTROPY_SOURCES

endmenu # "Specific DRNG seeding strategies"

endif # LRNG

endmenu # LRNG
```

## fs/zfs/Kconfig
```kconfig
config ZFS
	tristate "ZFS filesystem support"
	depends on EFI_PARTITION
	select ZLIB_INFLATE
	select ZLIB_DEFLATE
	help
	  This is the ZFS filesystem from the ZFS On Linux project.

	  See http://zfsonlinux.org/

	  To compile this file system support as a module, choose M here.

	  If unsure, say N.
```

## net/kcm/Kconfig
```kconfig
# SPDX-License-Identifier: GPL-2.0-only

config AF_KCM
	tristate "KCM sockets"
	depends on INET
	depends on !PREEMPT_RT
	select BPF_SYSCALL
	select STREAM_PARSER
	---help---
	  KCM (Kernel Connection Multiplexor) sockets provide a method
	  for multiplexing messages of a message based application
	  protocol over kernel connectons (e.g. TCP connections).
```

## security/brute/Kconfig
```kconfig
# SPDX-License-Identifier: GPL-2.0
config SECURITY_FORK_BRUTE
	bool "Fork brute force attack detection and mitigation"
	depends on SECURITY
	help
	  This is an LSM that stops any fork brute force attack against
	  vulnerable userspace processes. The detection method is based on
	  the application crash period and as a mitigation procedure all the
	  offending tasks are killed. Also, the executable file involved in the
	  attack will be marked as "not allowed" and new execve system calls
	  using this file will fail. Like capabilities, this security module
	  stacks with other LSMs.

	  If you are unsure how to answer this question, answer N.
```
